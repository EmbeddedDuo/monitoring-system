## Monitoring-system/components/wifi/Kconfig
```kconfig
menu "Wifi Configurations"
    config EXAMPLE_WIFI_SSID
        string "SSID of Network"
        default ""

    config EXAMPLE_WIFI_PASSWORD
        string "Password of Network"
        default ""
endmenu
```
